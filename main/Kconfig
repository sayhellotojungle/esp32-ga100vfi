## main/Kconfig
```kconfig
menu "GA100VFI glitcher"

	choice GA_I2C_DEFAULT_BAUD
		prompt "Default I2C bus speed (runtime switchable with @F)"
		default GA_I2C_BAUD_1M
		help
		  1 MHz is the reference rig's timing baseline: a 16-bit PMBus write
		  takes 36 us instead of 90 us at 400 kHz, and the reference recipe's
		  `delay` is calibrated against that. The card's SMBus pull-ups are
		  specified for 400 kHz only, so the firmware proves the rate with a
		  read-only probe at every bring-up and steps down 1 MHz -> 400 kHz
		  -> 100 kHz by itself. Pick a lower value here to start lower.

		config GA_I2C_BAUD_100K
			bool "100 kHz"
		config GA_I2C_BAUD_400K
			bool "400 kHz (Fm)"
		config GA_I2C_BAUD_1M
			bool "1 MHz (Fm+, reference baseline; auto-downgrade on failure)"
	endchoice

	config GA_I2C_BAUD_HZ
		int
		default 100000 if GA_I2C_BAUD_100K
		default 400000 if GA_I2C_BAUD_400K
		default 1000000 if GA_I2C_BAUD_1M

	config GA_ALLOW_OCTAL_PINS
		bool "Allow I2C/RST pins in the 33-37 range"
		default n
		help
		  GPIO33-37 are usable unless the module has octal SPI flash/PSRAM
		  (e.g. N8R8). Only enable this after checking your module.

endmenu
```
